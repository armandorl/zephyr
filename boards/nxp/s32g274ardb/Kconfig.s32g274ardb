## boards/nxp/s32g274ardb/Kconfig.s32g274ardb
```kconfig
# Copyright 2025 NXP
# SPDX-License-Identifier: Apache-2.0

config BOARD_S32G274ARDB
	select SOC_S32G274A_M7 if BOARD_S32G274ARDB_S32G274A_M7
	select SOC_PART_NUMBER_S32G274ARDB if BOARD_S32G274ARDB
```

## boards/nxp/s32g274ardb/board.yml
```yaml
board:
  name: s32g274ardb
  full_name: S32G274ARDB
  vendor: nxp
  socs:
    - name: s32g274a
```

## soc/nxp/s32/s32g2/Kconfig
```kconfig
# NXP S32K5XX MCUs series

# Copyright 2025 NXP
# SPDX-License-Identifier: Apache-2.0

config SOC_SERIES_S32G2
	select ARM
	select HAS_NXP_S32_HAL
	select CPU_HAS_FPU
	select CPU_HAS_ARM_MPU
	select CPU_HAS_ICACHE
	select CPU_HAS_DCACHE
	select SOC_EARLY_INIT_HOOK

config SOC_S32G274A_M7
	select CPU_CORTEX_M7
	select CPU_HAS_CUSTOM_FIXED_SOC_MPU_REGIONS
	select SOC_EARLY_RESET_HOOK if XIP
```

## soc/nxp/s32/s32g2/Kconfig.defconfig.s32g274.m7
```kconfig
# NXP S32G2XX MCU series

# Copyright 2025 NXP
# SPDX-License-Identifier: Apache-2.0

if SOC_S32G274_M7

config NUM_IRQS
	default 239

config NUM_IRQ_PRIO_BITS
    int
    default 4

config CMSIS_DEVICE_HEADER
    string
    default "S32G274_M7_COMMON.h"

config NXP_SIUL2_EIRQ_EXT_INTERRUPTS_MAX
    int
    default 16



endif # SOC_S32G274_M7
```

## soc/nxp/s32/s32g2/Kconfig.soc
```kconfig
# Copyright 2025 NXP
# SPDX-License-Identifier: Apache-2.0

config SOC_SERIES_S32G2
	bool
	select SOC_FAMILY_NXP_S32

config SOC_SERIES
	default "s32g2" if SOC_SERIES_S32G2

config SOC_S32G274
	bool
	select SOC_SERIES_S32G2

config SOC_S32G274_M7
	bool
	select SOC_S32G274

config SOC
	default "s32g274" if SOC_S32G274

config SOC_PART_NUMBER_S32G274ARDB
	bool

config SOC_PART_NUMBER
	default "S32G274ARDB" if SOC_PART_NUMBER_S32G274ARDB
```
