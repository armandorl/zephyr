/*
 * Copyright 2023 NXP
 *
 * SPDX-License-Identifier: Apache-2.0
 */

/ {
	chosen {
		zephyr,console = &linflexd0;
		zephyr,shell-uart = &linflexd0;
	};
};

&linflexd0 {
	pinctrl-0 = <&linflexd0_default>;
	pinctrl-names = "default";
	status = "okay";
};
