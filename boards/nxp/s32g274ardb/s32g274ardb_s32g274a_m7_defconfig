## boards/nxp/s32g274ardb/s32g274ardb_s32g274a_m7_defconfig
```kconfig
# Copyright 2025 NXP
# SPDX-License-Identifier: Apache-2.0

CONFIG_ARM_MPU=y
CONFIG_CLOCK_CONTROL=y
CONFIG_CLOCK_CONTROL_NXP_S32=y

CONFIG_SERIAL=y
CONFIG_UART_CONSOLE=y
CONFIG_CONSOLE=y
CONFIG_PRINTK=y

CONFIG_TIMING_FUNCTIONS=y
CONFIG_SYS_CLOCK_EXISTS=y
CONFIG_SYS_CLOCK_TICKS_PER_SEC=1000
CONFIG_CORTEX_M_SYSTICK=y
```

## dts/bindings/pinctrl/nxp,s32g-siul2-pinctrl.yaml
```yaml
# Copyright 2022, 2024-2025 NXP
# SPDX-License-Identifier: Apache-2.0

description: |
  NXP SIUL2 Pin Controller for S32G SoCs

  The NXP SIUL2 pin controller is a singleton node responsible for controlling
  the pin function selection and pin properties. This node, labeled 'pinctrl' in
  the SoC's devicetree, will define pin configurations in pin groups. Each group
  within the pin configuration defines the pin configuration for a peripheral,
  and each numbered subgroup in the pin group defines all the pins for that
  peripheral with the same configuration properties. The 'pinmux' property in
  a group selects the pins to be configured, and the remaining properties set
  configuration values for those pins.

  For example, to configure the pinmux for CAN0, modify the 'pinctrl' from your
  board or application devicetree overlay as follows:

    /* Include the SoC package header containing the predefined pins definitions */
    #include <nxp/s32/S32G274ARDB-pinctrl.h>

    &pinctrl {
      can0_default: can0_default {
        group1 {
          pinmux = <PF1_CAN0_TX>;
          output-enable;
        };
        group2 {
          pinmux = <PF5_CAN0_RX>;
          input-enable;
        };
      };
    };

  The 'can0_default' node contains the pin configurations for a particular state
  of a device. The 'default' state is the active state. Other states for the same
  device can be specified in separate child nodes of 'pinctrl'.

  In addition to 'pinmux' property, each group can contain other properties such as
  'bias-pull-up', 'slew-rate', 'nxp-drive-strength', or 'nxp-invert' that will be
  applied to all the pins defined in 'pinmux' array. To enable the input buffer use
  'input-enable' and to enable the output buffer use 'output-enable'.

  To link the pin configurations with CAN0 device, use pinctrl-N property in the
  device node, where 'N' is the zero-based state index (0 is the default state).
  Following previous example:

    &can0 {
      pinctrl-0 = <&can0_default>;
      pinctrl-names = "default";
      status = "okay";
    };

  If only the required properties are supplied, the pin configuration register
  will be assigned the following reset values:
    - input and output buffers disabled
    - internal pull not enabled
    - open drain disabled
    - drive strength disabled
    - slew rate 4 (see description in property below).

  Additionally:
  - Safe Mode is always kept as reset value (disabled).

compatible: "nxp,s32g-siul2-pinctrl"

include: base.yaml

child-binding:
  description: NXP SIUL2 pin controller pin group.
  child-binding:
    description: NXP SIUL2 pin controller pin configuration node.

    include:
      - name: pincfg-node.yaml
        property-allowlist:
          - bias-pull-down
          - bias-pull-up
          - drive-open-drain
          - slew-rate
          - input-enable
          - output-enable

    properties:
      pinmux:
        required: true
        type: array
        description: |
          An array of pins sharing the same group properties. The pins must be
          defined using the macros from the SoC package header. These macros
          encode all the pin muxing information in a 32-bit value.

      slew-rate:
        enum: [0, 4, 5, 6, 7]
        default: 4
        description: |
          Slew rate control. Reset value is 4.
          - For 3.3 V / 1.8 V FAST pads:
            0: FMAX = 208 MHz (at 1.8 V), 166 MHz (at 3.3 V)
            4: FMAX = 166 MHz (at 1.8 V), 150 MHz (at 3.3 V)
            5: FMAX = 150 MHz (at 1.8 V), 133 MHz (at 3.3 V)
            6: FMAX = 133 MHz (at 1.8 V), 100 MHz (at 3.3 V)
            7: FMAX = 100 MHz (at 1.8 V), 83 MHz (at 3.3 V)
          - For 1.8 V GPIO pads:
            0: FMAX = 208 MHz
            4: FMAX = 150 MHz
            5: FMAX = 133 MHz
            6: FMAX = 100 MHz
            7: FMAX = 50 MHz
          - For 3.3 V GPIO pads:
            0: Reserved
            4: FMAX = 50 MHz
            5: FMAX = 50 MHz
            6: FMAX = 50 MHz
            7: FMAX = 1 MHz

      nxp_drive_strength:
        type: boolean
        description: |
          Enable drive strength for the pin. When set to true, the pin will have
          increased driving capability (DSE bit set in MSCR register).

      nxp_invert:
        type: boolean
        description: |
          Invert the pin input/output. When set to true, the pin signal is inverted
          (INV bit set in MSCR register).
```
