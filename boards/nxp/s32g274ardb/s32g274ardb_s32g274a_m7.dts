/*
 * Copyright 2025 NXP
 *
 * SPDX-License-Identifier: Apache-2.0
 */

/dts-v1/;

#include <arm/nxp/nxp_s32g274a_m7.dtsi>
#include "s32g274ardb_s32g274a.dtsi"

/ {
	model = "NXP S32G274ARDB on Cortex-M7 cores";
	compatible = "nxp,s32g274ardb";

	chosen {
		zephyr,sram = &sram0;
		zephyr,flash = &cmram;
		zephyr,console = &linflexd0;
		zephyr,shell-uart = &linflexd0;
	};
};

&linflexd0 {
	pinctrl-0 = <&linflexd0_default>;
	pinctrl-names = "default";
	status = "okay";
};
