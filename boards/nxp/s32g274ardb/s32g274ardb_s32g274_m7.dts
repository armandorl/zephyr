/*
 * Copyright 2025 NXP
 *
 * SPDX-License-Identifier: Apache-2.0
 */

/dts-v1/;

#include <arm/nxp/nxp_s32g274_m7.dtsi>
#include "s32g274ardb_s32g274.dtsi"

/ {
	model = "NXP S32K566CVB on Cortex-M7 cores";
	compatible = "nxp,s32k566cvb";

	chosen {
		zephyr,sram = &sram0;
		zephyr,flash = &cmram;
	};
};
